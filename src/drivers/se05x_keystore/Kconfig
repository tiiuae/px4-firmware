## src/drivers/se05x_keystore/Kconfig
```kconfig
menuconfig DRIVERS_SE05X_KEYSTORE
	bool "se05x_keystore"
	default n
	---help---
		Keystore slots kept as data objects in an SE05x
```

## src/lib/ele_csr/Kconfig
```kconfig
menuconfig LIB_ELE_CSR
	bool "ele_csr"
	default n
	---help---
		Build a PKCS#10 certificate request for the identity key held in
		the EdgeLock Enclave, signed by it. The private half is never
		read, because no command returns it.
```

## src/lib/ztcs_secure_link/Kconfig
```kconfig
menuconfig LIB_ZTCS_SECURE_LINK
	bool "Secure link (Noise IK)"
	default n
	---help---
		Terminate Noise_IK_25519_ChaChaPoly_SHA256 against the ground
		station, so MAVLink leaves the aircraft encrypted and
		authenticated. The ground station end is ztcs-mavlink-gateway.

		Needs the PX4 crypto backend for the keystore the keys come
		from, and CONFIG_CRYPTO in the NuttX configuration for SHA-256,
		HMAC, Poly1305 and X25519, and a seeded /dev/random for the
		ephemeral keys. A session key drawn from an unseeded pool is
		worthless whatever the protocol above it.

config LIB_ZTCS_SECURE_LINK_HFS
	bool "Hybrid forward secrecy (ML-KEM-768)"
	depends on LIB_ZTCS_SECURE_LINK
	default n
	---help---
		Add ML-KEM-768 to the handshake beside X25519, so a session
		recorded today is not readable by a quantum computer later.
		The session holds if either half holds.

		Both ends or neither: the protocol name is part of the hash,
		so a station without it cannot open a link from an aircraft
		with it. The ground station end is the gateway's `hfs`
		feature.

		Handshake messages grow to 1394 and 1153 bytes, which the
		radio carries in about 0.45 s each way, once per rekey.
		Transport frames do not change.

config PX4_NOISE_KEM_STACKSIZE
	int "Stack for the KEM worker"
	depends on LIB_ZTCS_SECURE_LINK_HFS
	default 32768
	---help---
		ML-KEM-768 needs far more stack than a syscall has: measured
		at 18.6 KB to generate a keypair and 22.9 KB to decapsulate,
		against the 8 KB a syscall runs on. The handshake therefore
		runs on a thread of its own and the caller waits. One stack
		for the system, rather than raising every task's.

config LIB_ZTCS_SECURE_LINK_IDENTITY_PATH
	string "Signed identity payload"
	depends on LIB_ZTCS_SECURE_LINK
	default "/fs/certs/ztcs-identity"
	---help---
		Where the signed identity payload is cached. It is public and
		checked against the live keys when read, so any persistent
		path will do.
```

## src/modules/log_erase_trigger/Kconfig
```kconfig
menuconfig MODULES_LOG_ERASE_TRIGGER
	bool "log_erase_trigger"
	default n
	---help---
		Enable support for log_erase_trigger
```

## src/modules/logger/Kconfig
```kconfig
menuconfig MODULES_LOGGER
	bool "logger"
	default n
	---help---
		Enable support for logger

menuconfig USER_LOGGER
	bool "logger running as userspace module"
	default y
	depends on BOARD_PROTECTED && MODULES_LOGGER
	---help---
		Put logger in userspace memory

menuconfig LOGGER_STACK_SIZE
	int "stack size of logger task"
	default 3700
	depends on MODULES_LOGGER
	---help---
		Stack size of the logger task. Some configurations require more stack
		than the default.

menuconfig LOGGER_PARALLEL_LOGGING
	bool "Custom mavlink logging protocol in logger"
	default n
	depends on MODULES_LOGGER
	---help---
		Utilize custom mavlink logging protocol for speed up logging start phase
```

## src/modules/mavlink/Kconfig
```kconfig
menuconfig MODULES_MAVLINK
	bool "mavlink"
	default n
	---help---
		Enable support for mavlink

menuconfig MAVLINK_DIALECT
depends on MODULES_MAVLINK
        string "Mavlink dialect"
        default "common"
	---help---
		Select the Mavlink dialect to generate and use.

menuconfig MAVLINK_UAVCAN_PARAMETERS
depends on MODULES_MAVLINK && DRIVERS_UAVCAN
        bool "Mavlink UAVCAN parameter support"
        default y
	---help---
		Expose UAVCAN parameters over Mavlink.

menuconfig USER_MAVLINK
	bool "mavlink running as userspace module"
	default y
	depends on BOARD_PROTECTED && MODULES_MAVLINK
	---help---
		Put mavlink in userspace memory

menuconfig MAVLINK_SHELL_REQUIRES_SECURE_LINK
	bool "MAVLink shell only over an established secure link"
	default n
	depends on MODULES_MAVLINK && LIB_ZTCS_SECURE_LINK
	---help---
		A shell is root. Refuse SERIAL_CONTROL on any instance whose peer
		has not authenticated, which includes USB.
```

## src/modules/prodtest/Kconfig
```kconfig
menuconfig MODULES_PRODTEST
	bool "prodtest"
	default n
	---help---
		Enable support for prodtest. Provides the platform dependencies that
		are normally pulled in by the full set of flight modules, so that a
		minimal production test image (sensor drivers + listener) links, and
		a 'prodtest' command to summarize the published sensor topics.
```

## src/modules/uxrce_dds_client/Kconfig
```kconfig
menuconfig MODULES_UXRCE_DDS_CLIENT
	bool "uxrce_dds_client"
	default n
	---help---
		Enable support for the UXRCE-DDS Client

menuconfig UXRCE_DDS_CLIENT_USE_DDS_V3
depends on MODULES_UXRCE_DDS_CLIENT
	bool "use DDS v3"
	default n
	---help---
		Enable support for Micro-XRCE-DDS-Client version 3.

menuconfig USER_UXRCE_DDS_CLIENT
	bool "uxrce_dds_client running as userspace module"
	default y
	depends on BOARD_PROTECTED && MODULES_UXRCE_DDS_CLIENT
	---help---
		Put uxrce_dds_client in userspace memory

menuconfig UXRCE_DDS_TOPICS_YAML
	string "dds topics .yaml file name"
	default "dds_topics.yaml"
	depends on MODULES_UXRCE_DDS_CLIENT
	---help---
		Filename for yaml file for generating topics sources
```

## src/systemcmds/ele/Kconfig
```kconfig
menuconfig SYSTEMCMDS_ELE
	bool "ele"
	default n
	depends on SSRC_CRYPTO_IMX9
	---help---
		Drive the identity key held inside the i.MX93 EdgeLock Enclave:
		read its public half and ask it for a signature. The private half
		never leaves the enclave.
```

## src/systemcmds/isolation/Kconfig
```kconfig
menuconfig SYSTEMCMDS_ISOLATION
	bool "isolation"
	default n
	depends on BOARD_PROTECTED
	---help---
		Enable support for isolation, which checks the kernel boundary

menuconfig USER_ISOLATION
	bool "isolation running as userspace module"
	default y
	depends on BOARD_PROTECTED && SYSTEMCMDS_ISOLATION
	---help---
		Put isolation in userspace memory
```

## src/systemcmds/se05x/Kconfig
```kconfig
menuconfig SYSTEMCMDS_SE05X
	bool "se05x"
	default n
	depends on PLATFORM_NUTTX
	---help---
		Read the identity of an NXP SE05x secure element on /dev/se05x
```

## src/systemcmds/secure_mavlink_enroll/Kconfig
```kconfig
menuconfig SYSTEMCMDS_SECURE_MAVLINK_ENROLL
	bool "secure_mavlink_enroll"
	default n
	depends on LIB_SECURE_MAVLINK
	---help---
		Enrol this aircraft for secure MAVLink: read the link
		public key out, and write the ground station key and the identity
		payload back in. The ground end is ztcs-mavlink-provision.

menuconfig USER_SECURE_MAVLINK_ENROLL
	bool "secure_mavlink_enroll running as userspace module"
	default y
	depends on BOARD_PROTECTED && SYSTEMCMDS_SECURE_MAVLINK_ENROLL
	---help---
		Put secure_mavlink_enroll in userspace memory. It reaches the
		keystore through the crypto ioctls, like MAVLink, and in the
		kernel it would carry a second copy of the Noise core beside the
		kernel layer's own.
```

## src/systemcmds/xrdc2/Kconfig
```kconfig
menuconfig SYSTEMCMDS_XRDC2
	bool "xrdc2"
	default n
	depends on PLATFORM_NUTTX
	---help---
		Check the i.MX RT117x XRDC2 fence: an eDMA copy from normal RAM
		lands, one from the kernel key region ends in a bus error.
```

## src/systemcmds/ztcs_enroll/Kconfig
```kconfig
menuconfig SYSTEMCMDS_ZTCS_ENROLL
	bool "ztcs_enroll"
	default n
	depends on LIB_ZTCS_SECURE_LINK
	---help---
		Enrol this aircraft on the secure MAVLink link: read the link
		public key out, and write the ground station key and the identity
		payload back in. The ground end is ztcs-mavlink-provision.
```
