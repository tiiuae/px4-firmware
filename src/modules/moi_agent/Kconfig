## src/modules/moi_agent/Kconfig
```kconfig
menuconfig MODULES_MOI_AGENT
	bool "moi_agent"
	default n
	---help---
		Enable M-O-I Agent
```

## src/modules/redundancy/Kconfig
```kconfig
menuconfig MODULES_REDUNDANCY
	bool "Redundant FCs present"
	default n
	---help---
		Enable support for FC redundancy, i.e. multiple FCs on the drone

menuconfig USER_REDUNDANCY
	bool "Redundancy running as userspace module"
	default y
	depends on BOARD_PROTECTED && MODULES_REDUNDANCY
	---help---
		Put redundancy in userspace memory
```

## src/modules/rust_module_test/Kconfig
```kconfig
menuconfig MODULES_RUST_MODULE_TEST
	bool "rust_module_test"
	default n
	---help---
		Enable rust module test

menuconfig USER_RUST_MODULE_TEST
	bool "rust module test in user"
	default y
	depends on BOARD_PROTECTED && MODULES_RUST_MODULE_TEST
	---help---
		Put rust module test in userspace memory
```

## src/modules/rust_test/Kconfig
```kconfig
menuconfig MODULES_RUST_TEST
	bool "rust_test"
	default y
	---help---
		Enable rust test

menuconfig USER_RUST_TEST
	bool "rust test in user"
	default y
	depends on BOARD_PROTECTED && MODULES_RUST_TEST
	---help---
		Put rust_test in userspace memory
```

## src/modules/secure_mavlink_udp_proxy/Kconfig
```kconfig
menuconfig MODULES_SECURE_MAVLINK_UDP_PROXY
	bool "secure_mavlink_udp"
	default n
	---help---
		Enable secure MAVLink UDP communication with QGC using proxies
```

## src/modules/ztss_decision_engine/Kconfig
```kconfig
menuconfig MODULES_ZTSS_DECISION_ENGINE
	bool "ztss_decision_engine"
	default y
	---help---
		Enable ZTSS Decision Engine module for safety translation of facts to actions
```

## src/modules/ztss_monitor/Kconfig
```kconfig
menuconfig MODULES_ZTSS_MONITOR
    bool "ztss_monitor"
    default n
    ---help---
        Enable ZTSS Monitor module for safety monitoring
```

## src/modules/ztss_safe_actions/Kconfig
```kconfig
menuconfig MODULES_ZTSS_SAFE_ACTIONS
	bool "ztss_safe_actions"
	default y
	---help---
		Enable ZTSS safe actions module for safety actuation
```

## src/systemcmds/cert_test/Kconfig
```kconfig
menuconfig SYSTEMCMDS_CERT_TEST
	bool "cert_test"
	default n
	---help---
		Enable support for certification tests

menuconfig USER_CERT_TEST
	bool "cert test running as userspace module"
	default y
	depends on BOARD_PROTECTED && SYSTEMCMDS_CERT_TEST
	---help---
		Put certification tests in userspace memory
```

## src/systemcmds/kparam/Kconfig
```kconfig
menuconfig SYSTEMCMDS_KPARAM
	bool "param"
	default y
	depends on BOARD_PROTECTED && SYSTEMCMDS_PARAM
	---help---
		Enable support for param

config USER_KPARAM
	bool
	default n
	depends on BOARD_PROTECTED && SYSTEMCMDS_KPARAM
```

## src/systemcmds/kperf/Kconfig
```kconfig
menuconfig SYSTEMCMDS_KPERF
	bool "kperf"
	default y
	depends on BOARD_PROTECTED && SYSTEMCMDS_PERF
	---help---
		Enable support for kernel side perf

config USER_KPERF
	bool
	default n
	depends on BOARD_PROTECTED && SYSTEMCMDS_KPERF
```

## src/systemcmds/tee_test/Kconfig
```kconfig
menuconfig SYSTEMCMDS_TEE_TEST
	bool "tee_test"
	default y
	---help---
		Enable support for tee_test

menuconfig USER_TEE_TEST
	bool "tee_test running as userspace module"
	default y
	depends on BOARD_PROTECTED && SYSTEMCMDS_TEE_TEST
	---help---
		Put tee_test in userspace memory
```
